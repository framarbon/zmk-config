## config/west.yml
```yaml
manifest:
  remotes:
    - name: zmkfirmware
      url-base: https://github.com/zmkfirmware
    - name: framarbon # <-- add this for the keyboard
      url-base: https://github.com/framarbon
    - name: caksoylar # <-- and this for the LED
      url-base: https://github.com/caksoylar
    - name: englmaxi # <-- if you want a dongle
      url-base: https://github.com/englmaxi
    - name: urob
      url-base: https://github.com/urob
    - name: infused-kim
      url-base: https://github.com/infused-kim
  projects:
    - name: zmk
      remote: zmkfirmware
      revision: main
      import: app/west.yml
    # infused-kim's zmk fork with mouse PR AND urob's improvements, which
    # might be out-dated, but is known to be compatible with PS/2 mouse & TP
    # driver module.
    # - name: zmk
    #   remote: infused-kim
    #   revision: pr-testing/mouse_ps2_module_base_urob
    #   import: app/west.yml
    - name: zmk-helpers
      remote: urob
      revision: main
    - name: zmk-adaptive-key
      remote: urob
      revision: main
    - name: lintilla # <-- add this for the keyboard
      remote: framarbon
      revision: zmk
    - name: zmk-rgbled-widget # <-- and this for the LED
      remote: caksoylar
      revision: main
    - name: zmk-dongle-display
      remote: englmaxi
      revision: main
    # Module for PS/2 mouse & TP driver
    - name: kb_zmk_ps2_mouse_trackpoint_driver
      # remote: infused-kim
      remote: framarbon
      revision: main
  self:
    path: config
```
